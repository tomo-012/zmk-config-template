## config/Kconfig
```kconfig
config SHIELD_MY38KEY_LEFT
    def_bool $(shields_list_contains,my38key_left)

config SHIELD_MY38KEY_RIGHT
    def_bool $(shields_list_contains,my38key_right)
```

## config/boards/shields/my38key/Kconfig.defconfig
```kconfig
if SHIELD_MY38KEY_LEFT || SHIELD_MY38KEY_RIGHT

config ZMK_KEYBOARD_NAME
    default "my38key"

endif
```

## config/west.yml
```yaml
manifest:
  projects:
    - name: zmk
      url: https://github.com
      revision: main
      import: app/west.yml
  self:
    path: config
```
